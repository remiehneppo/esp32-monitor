#include "display_ssd1306.h"
#include <stdbool.h>
#include <stdlib.h>
#include <string.h>
#include "esp_log.h"

static const char *TAG = "SSD1306";

// Local Framebuffer (128x64 pixels -> 128 columns * 8 pages = 1024 bytes)
static uint8_t frame_buffer[1024];
static uint8_t oled_i2c_address = SSD1306_I2C_ADDRESS;

// Standard 8x8 font bitmap for ASCII characters (0x20 to 0x7F)
static const uint8_t font8x8[96][8] = {
    {0x00, 0x00, 0x00, 0x00, 0x00, 0x00, 0x00, 0x00}, // Space
    {0x00, 0x00, 0x00, 0x4f, 0x4f, 0x00, 0x00, 0x00}, // !
    {0x00, 0x07, 0x07, 0x00, 0x07, 0x07, 0x00, 0x00}, // "
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    {0x08, 0x1c, 0x0e, 0x1c, 0x08, 0x00, 0x00, 0x00}, // ~ (used as Arrow Down)
};

static esp_err_t ssd1306_write_cmd(uint8_t cmd)
{
    i2c_cmd_handle_t cmd_link = i2c_cmd_link_create();
    i2c_master_start(cmd_link);
    i2c_master_write_byte(cmd_link, (oled_i2c_address << 1) | I2C_MASTER_WRITE, true);
    i2c_master_write_byte(cmd_link, 0x00, true); // Control byte: Co = 0, D/C# = 0
    i2c_master_write_byte(cmd_link, cmd, true);
    i2c_master_stop(cmd_link);
    esp_err_t ret = i2c_master_cmd_begin(I2C_MASTER_NUM, cmd_link, pdMS_TO_TICKS(100));
    i2c_cmd_link_delete(cmd_link);
    return ret;
}

static esp_err_t ssd1306_write_data(const uint8_t *data, size_t len)
{
    i2c_cmd_handle_t cmd_link = i2c_cmd_link_create();
    i2c_master_start(cmd_link);
    i2c_master_write_byte(cmd_link, (oled_i2c_address << 1) | I2C_MASTER_WRITE, true);
    i2c_master_write_byte(cmd_link, 0x40, true); // Control byte: Co = 0, D/C# = 1
    i2c_master_write(cmd_link, data, len, true);
    i2c_master_stop(cmd_link);
    esp_err_t ret = i2c_master_cmd_begin(I2C_MASTER_NUM, cmd_link, pdMS_TO_TICKS(100));
    i2c_cmd_link_delete(cmd_link);
    return ret;
}

static esp_err_t ssd1306_probe_address(uint8_t addr)
{
    oled_i2c_address = addr;
    return ssd1306_write_cmd(0xAE);
}

void ssd1306_draw_pixel(uint8_t x, uint8_t y, bool on)
{
    if (x >= SSD1306_WIDTH || y >= SSD1306_HEIGHT) return;

    size_t idx = (size_t)(y / 8) * SSD1306_WIDTH + x;
    uint8_t mask = (uint8_t)(1U << (y & 7));
    if (on) {
        frame_buffer[idx] |= mask;
    } else {
        frame_buffer[idx] &= (uint8_t)~mask;
    }
}

esp_err_t ssd1306_init(void)
{
    // 1. Configure I2C Master Interface
    i2c_config_t conf = {
        .mode = I2C_MODE_MASTER,
        .sda_io_num = I2C_MASTER_SDA_IO,
        .sda_pullup_en = GPIO_PULLUP_ENABLE,
        .scl_io_num = I2C_MASTER_SCL_IO,
        .scl_pullup_en = GPIO_PULLUP_ENABLE,
        .master.clk_speed = I2C_MASTER_FREQ_HZ,
    };
    esp_err_t err = i2c_param_config(I2C_MASTER_NUM, &conf);
    if (err != ESP_OK) return err;

    err = i2c_driver_install(I2C_MASTER_NUM, conf.mode, I2C_MASTER_RX_BUF_DISABLE, I2C_MASTER_TX_BUF_DISABLE, 0);
    if (err != ESP_OK) return err;

    vTaskDelay(pdMS_TO_TICKS(100));
    ESP_LOGI(TAG, "I2C initialized successfully. Configuring SSD1306 OLED...");

    const uint8_t candidate_addresses[] = {0x3C, 0x3D};
    err = ESP_FAIL;
    for (size_t i = 0; i < sizeof(candidate_addresses); ++i) {
        err = ssd1306_probe_address(candidate_addresses[i]);
        if (err == ESP_OK) {
            ESP_LOGI(TAG, "SSD1306 detected at I2C address 0x%02X", candidate_addresses[i]);
            break;
        }
    }
    if (err != ESP_OK) {
        ESP_LOGE(TAG, "SSD1306 not responding on 0x3C or 0x3D");
        return err;
    }

    // 2. Initialize SSD1306 Display
    uint8_t init_cmds[] = {
        0xAE,          // Turn display off
        0xD5, 0x80,    // Set display clock divide ratio/oscillator frequency
        0xA8, 0x3F,    // Set multiplex ratio (1 to 64)
        0xD3, 0x00,    // Set display offset
        0x40,          // Set start line address
        0x8D, 0x14,    // Enable charge pump (CRITICAL for OLED screens)
        0x20, 0x00,    // Set Memory Addressing Mode to Horizontal Mode
        0xA1,          // Set Segment Re-map (A0h=col 0 maps to SEG0, A1h=col 127 maps to SEG0)
        0xC8,          // Set COM Output Scan Direction (C0h=normal, C8h=remapped)
        0xDA, 0x12,    // Set COM pins hardware configuration
        0x81, 0xCF,    // Set contrast control (0 to 255)
        0xD9, 0xF1,    // Set pre-charge period
        0xDB, 0x40,    // Set VCOMH deselect level
        0xA4,          // Entire display on (output follows RAM content)
        0xA6,          // Set normal display (not inverse)
        0xAF           // Turn display on
    };

    for (size_t i = 0; i < sizeof(init_cmds); i++) {
        err = ssd1306_write_cmd(init_cmds[i]);
        if (err != ESP_OK) {
            ESP_LOGE(TAG, "Failed sending init command %d (0x%02X)", i, init_cmds[i]);
            return err;
        }
    }

    ESP_LOGI(TAG, "SSD1306 OLED screen configured successfully!");
    ssd1306_clear();
    return ssd1306_update();
}

void ssd1306_clear(void)
{
    memset(frame_buffer, 0, sizeof(frame_buffer));
}

esp_err_t ssd1306_update(void)
{
    esp_err_t err = ESP_OK;

    for (uint8_t page = 0; page < 8; ++page) {
        err = ssd1306_write_cmd(0x21); // Set Column Address
        if (err != ESP_OK) return err;
        err = ssd1306_write_cmd(0x00); // Column Start
        if (err != ESP_OK) return err;
        err = ssd1306_write_cmd(0x7F); // Column End
        if (err != ESP_OK) return err;

        err = ssd1306_write_cmd(0x22); // Set Page Address
        if (err != ESP_OK) return err;
        err = ssd1306_write_cmd(page);
        if (err != ESP_OK) return err;
        err = ssd1306_write_cmd(page);
        if (err != ESP_OK) return err;

        err = ssd1306_write_data(&frame_buffer[(size_t)page * SSD1306_WIDTH], SSD1306_WIDTH);
        if (err != ESP_OK) return err;
    }

    return err;
}

void ssd1306_draw_char(uint8_t x, uint8_t page, char c)
{
    if (x > SSD1306_WIDTH - 8 || page > 7) return;

    // Standard ASCII offset
    uint8_t c_idx = (uint8_t)c;
    if (c_idx < 32 || c_idx > 127) {
        c_idx = 32; // Default to space
    }
    c_idx -= 32;

    // Draw the 8 bytes representing 8 columns of the character
    for (int col = 0; col < 8; col++) {
        frame_buffer[page * SSD1306_WIDTH + x + col] = font8x8[c_idx][col];
    }
}

void ssd1306_draw_string(uint8_t x, uint8_t page, const char *str)
{
    uint8_t cur_x = x;
    while (*str) {
        if (cur_x > SSD1306_WIDTH - 8) break; // Exceeds boundary
        ssd1306_draw_char(cur_x, page, *str);
        cur_x += 8; // Move to next character slot
        str++;
    }
}

void ssd1306_draw_line(int x0, int y0, int x1, int y1, bool on)
{
    int dx = abs(x1 - x0);
    int sx = x0 < x1 ? 1 : -1;
    int dy = -abs(y1 - y0);
    int sy = y0 < y1 ? 1 : -1;
    int err = dx + dy;

    while (1) {
        if (x0 >= 0 && x0 < SSD1306_WIDTH && y0 >= 0 && y0 < SSD1306_HEIGHT) {
            ssd1306_draw_pixel((uint8_t)x0, (uint8_t)y0, on);
        }
        if (x0 == x1 && y0 == y1) break;

        int e2 = 2 * err;
        if (e2 >= dy) {
            err += dy;
            x0 += sx;
        }
        if (e2 <= dx) {
            err += dx;
            y0 += sy;
        }
    }
}

void ssd1306_draw_bar(uint8_t page, uint8_t start_x, uint8_t end_x, uint8_t percentage)
{
    if (start_x >= end_x || end_x >= SSD1306_WIDTH || page > 7) return;

    uint8_t width = end_x - start_x + 1;
    uint8_t filled_width = (width * percentage) / 100;

    // Render bar pattern:
    // Left edge (0x7E), Right edge (0x7E)
    // Center: top and bottom lines (0x42), filled segments (0x7E or 0x5C pattern for a nice block)
    // 0x42 = 01000010 (top/bottom outline)
    // 0x7E = 01111110 (solid fill)
    for (uint8_t col = 0; col < width; col++) {
        uint8_t cur_x = start_x + col;
        uint8_t pattern = 0x00;

        if (col == 0 || col == width - 1) {
            pattern = 0x7E; // Border ends
        } else if (col <= filled_width) {
            pattern = 0x7E; // Solid block fill
        } else {
            pattern = 0x42; // Outline
        }

        frame_buffer[page * SSD1306_WIDTH + cur_x] = pattern;
    }
}
